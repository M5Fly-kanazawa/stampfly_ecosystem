## firmware/controller/sdkconfig.defaults
```kconfig
# ESP32-S3 ターゲット設定 (M5Stack AtomS3)
CONFIG_IDF_TARGET="esp32s3"

# フラッシュサイズ (8MB)
CONFIG_ESPTOOLPY_FLASHSIZE_8MB=y

# パーティションテーブル
CONFIG_PARTITION_TABLE_CUSTOM=y
CONFIG_PARTITION_TABLE_CUSTOM_FILENAME="partitions.csv"

# シリアルモニタ速度
CONFIG_ESP_CONSOLE_UART_BAUDRATE=115200

# FreeRTOS 設定
CONFIG_FREERTOS_HZ=1000

# WiFi 設定
CONFIG_ESP_WIFI_STATIC_RX_BUFFER_NUM=10
CONFIG_ESP_WIFI_DYNAMIC_RX_BUFFER_NUM=32

# ログレベル
CONFIG_LOG_DEFAULT_LEVEL_INFO=y

# C++ 例外サポート
CONFIG_COMPILER_CXX_EXCEPTIONS=y

# SPIFFS 設定
CONFIG_SPIFFS_MAX_PARTITIONS=3
```

## firmware/platform/components/sf_hal_bmi270/examples/development/stage2_init/sdkconfig.defaults
```kconfig
# ESP32-S3 Target Configuration
CONFIG_IDF_TARGET="esp32s3"

# CPU Frequency (240 MHz for ESP32-S3)
CONFIG_ESP_DEFAULT_CPU_FREQ_MHZ_240=y

# Log Level
CONFIG_LOG_DEFAULT_LEVEL_INFO=y
CONFIG_LOG_MAXIMUM_LEVEL_VERBOSE=y

# FreeRTOS Configuration
CONFIG_FREERTOS_HZ=1000

# SPI Configuration
CONFIG_SPI_MASTER_ISR_IN_IRAM=y
```

## firmware/vehicle/components/sf_hal_pmw3901/examples/basic_cpp/sdkconfig.defaults
```kconfig
# ESP32-S3 specific configuration for StampFly
CONFIG_IDF_TARGET="esp32s3"

# Flash size
CONFIG_ESPTOOLPY_FLASHSIZE_8MB=y

# Partition table
CONFIG_PARTITION_TABLE_SINGLE_APP=y

# FreeRTOS
CONFIG_FREERTOS_HZ=1000

# Log level - set to INFO to suppress verbose/debug output
CONFIG_LOG_DEFAULT_LEVEL_INFO=y
CONFIG_LOG_MAXIMUM_LEVEL_INFO=y

# Component log levels - suppress verbose output
CONFIG_LOG_COLORS=y
CONFIG_BOOTLOADER_LOG_LEVEL_WARN=y

# C++ support (required for C++ wrapper)
CONFIG_COMPILER_CXX_EXCEPTIONS=y
CONFIG_COMPILER_CXX_RTTI=y
CONFIG_COMPILER_CXX_STD_17=y
```

## firmware/vehicle/sdkconfig.defaults
```kconfig
# StampFly RTOS Skeleton - Default SDK Configuration
# Target: ESP32-S3 (M5StampS3)

# Target
CONFIG_IDF_TARGET="esp32s3"

# Flash size
CONFIG_ESPTOOLPY_FLASHSIZE_8MB=y
CONFIG_ESPTOOLPY_FLASHSIZE="8MB"

# Partition table
CONFIG_PARTITION_TABLE_CUSTOM=y
CONFIG_PARTITION_TABLE_CUSTOM_FILENAME="partitions.csv"

# FreeRTOS
CONFIG_FREERTOS_HZ=1000
CONFIG_FREERTOS_UNICORE=n

# CPU frequency
CONFIG_ESP_DEFAULT_CPU_FREQ_MHZ_240=y

# USB Serial/JTAG Console (more reliable for debugging)
CONFIG_ESP_CONSOLE_USB_SERIAL_JTAG=y
CONFIG_ESP_CONSOLE_SECONDARY_NONE=y

# Log level
CONFIG_LOG_DEFAULT_LEVEL_INFO=y
CONFIG_LOG_MAXIMUM_LEVEL_DEBUG=y

# Watchdog
CONFIG_ESP_TASK_WDT_TIMEOUT_S=10

# WiFi for ESP-NOW and Telemetry
CONFIG_ESP_WIFI_STATIC_RX_BUFFER_NUM=10
CONFIG_ESP_WIFI_DYNAMIC_RX_BUFFER_NUM=32
CONFIG_ESP_WIFI_AMPDU_TX_ENABLED=n
CONFIG_ESP_WIFI_AMPDU_RX_ENABLED=n
CONFIG_ESP_WIFI_SOFTAP_SUPPORT=y
CONFIG_ESP_WIFI_IRAM_OPT=y

# HTTP Server (WebSocket support for telemetry)
CONFIG_HTTPD_WS_SUPPORT=y

# NVS
CONFIG_NVS_DEFAULT_PART_SIZE=0x6000

# SPI
CONFIG_SPI_MASTER_IN_IRAM=y

# I2C
CONFIG_I2C_ISR_IRAM_SAFE=y

# GPIO
CONFIG_GPIO_CTRL_FUNC_IN_IRAM=y

# LEDC (PWM)
CONFIG_LEDC_CTRL_FUNC_IN_IRAM=y

# RMT (for WS2812)
CONFIG_RMT_ISR_IRAM_SAFE=y

# C++ exceptions (required by stampfly_opticalflow)
CONFIG_COMPILER_CXX_EXCEPTIONS=y
```

## firmware/vehicle_new/components/sf_hal_bmi270/examples/development/stage1_spi_basic/sdkconfig.defaults
```kconfig
# ESP32-S3 Configuration for BMI270 Stage 1 Test

# Target configuration
CONFIG_IDF_TARGET="esp32s3"

# Component config
CONFIG_FREERTOS_HZ=1000

# Log level
CONFIG_LOG_DEFAULT_LEVEL_INFO=y
CONFIG_LOG_MAXIMUM_LEVEL_VERBOSE=y

# SPI Configuration
CONFIG_SPI_MASTER_IN_IRAM=n
CONFIG_SPI_MASTER_ISR_IN_IRAM=n

# ESP32-S3 specific
CONFIG_ESP_DEFAULT_CPU_FREQ_MHZ_240=y
CONFIG_ESP_TASK_WDT_TIMEOUT_S=10
```

## firmware/vehicle_new/components/sf_hal_vl53l3cx/Kconfig
```kconfig
menu "StampFly ToF Sensor Configuration"

    config STAMPFLY_TOF_I2C_SDA_GPIO
        int "I2C SDA GPIO"
        default 3
        help
            GPIO number for I2C SDA line (StampFly default: GPIO3)

    config STAMPFLY_TOF_I2C_SCL_GPIO
        int "I2C SCL GPIO"
        default 4
        help
            GPIO number for I2C SCL line (StampFly default: GPIO4)

    config STAMPFLY_TOF_I2C_FREQ_HZ
        int "I2C Frequency (Hz)"
        default 400000
        help
            I2C clock frequency in Hz (400kHz recommended for VL53L3CX)

    config STAMPFLY_TOF_FRONT_XSHUT_GPIO
        int "Front ToF XSHUT GPIO"
        default 9
        help
            GPIO for front ToF sensor XSHUT pin

    config STAMPFLY_TOF_FRONT_INT_GPIO
        int "Front ToF INT GPIO"
        default 8
        help
            GPIO for front ToF sensor interrupt pin

    config STAMPFLY_TOF_BOTTOM_XSHUT_GPIO
        int "Bottom ToF XSHUT GPIO"
        default 7
        help
            GPIO for bottom ToF sensor XSHUT pin

    config STAMPFLY_TOF_BOTTOM_INT_GPIO
        int "Bottom ToF INT GPIO"
        default 6
        help
            GPIO for bottom ToF sensor interrupt pin

    config STAMPFLY_TOF_TIMING_BUDGET_MS
        int "Timing Budget (ms)"
        default 33
        range 8 500
        help
            Measurement timing budget in milliseconds

endmenu
```
